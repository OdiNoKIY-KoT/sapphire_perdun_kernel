// SPDX-License-Identifier: GPL-2.0-only
/*
 * Redmi Note 13 4G (sapphire / sapphiren) display + touch techpack overlay.
 * Merged into the sapphire/sapphiren dtbo entries with fdtoverlaymerge.
 */

/dts-v1/;
/plugin/;

#include "khaje-sde-display.dtsi"
#include "sapphire-touchscreen.dtsi"

/ {
	model = "Qualcomm Technologies, Inc. Khaje IDP sapphire";
	compatible = "qcom,khaje-idp", "qcom,khaje", "qcom,idp";
	qcom,msm-id = <518 0x10000>, <586 0x10000>;
	qcom,board-id = <0x20022 0>, <0x30022 0>;
	qcom,pmic-id = <0x2D 0x2E 0x0 0x0>;
};
